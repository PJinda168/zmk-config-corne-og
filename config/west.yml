## config/west.yml
```yaml
manifest:
  remotes:
    - name: zmkfirmware
      url-base: https://github.com/zmkfirmware
    - name: infely                             # new entry
      url-base: https://github.com/infely      # new entry

  projects:
    - name: zmk
      remote: zmkfirmware
      revision: v0.2
      import: app/west.yml
    - name: nice-view-battery                  # new entry
      remote: infely                           # new entry
      revision: v0.2                          # new entry

  self:
    path: config
```
